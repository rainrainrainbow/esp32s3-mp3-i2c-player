## sdkconfig.defaults
```kconfig
# No PSRAM - internal RAM only
CONFIG_SPIRAM=n
CONFIG_ESP32S3_SPIRAM_SUPPORT=n
CONFIG_SPIRAM_BOOT_INIT=n
CONFIG_SPIRAM_ALLOW_BSS_SEG_EXTERNAL_MEMORY=n
CONFIG_ESP32S3_DEFAULT_CPU_FREQ_240=y
CONFIG_ESP_TASK_WDT=n
CONFIG_ESP_TASK_WDT_PANIC=n
CONFIG_INT_WDT=n
CONFIG_ESP_COREDUMP_ENABLE=n
CONFIG_USB_OTG_SUPPORTED=y
```
